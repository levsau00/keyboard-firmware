## config/boards/shields/lev/Kconfig.defconfig
```kconfig
if SHIELD_LEV_LEFT || SHIELD_LEV_RIGHT

config ZMK_KEYBOARD_NAME
    default "lev"

config ZMK_SPLIT
    default y

config EC11
    default y

endif
```

## config/boards/shields/lev/Kconfig.shield
```kconfig
config SHIELD_LEV_LEFT
    def_bool $(shields_list_contains,lev_left)

config SHIELD_LEV_RIGHT
    def_bool $(shields_list_contains,lev_right)
```
