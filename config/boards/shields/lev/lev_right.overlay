#include "lev.dtsi"

/ {
    chosen {
        zmk,kscan = &kscan0;
        zmk,matrix-transform = &default_transform;
    };
};

&default_transform {
    col-offset = <7>;
};

&encoder {
    status = "okay";
};
