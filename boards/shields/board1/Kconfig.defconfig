## boards/shields/board1/Kconfig.defconfig
```kconfig
if SHIELD_BOARD1_LEFT

config ZMK_KEYBOARD_NAME
    default "board1"

config ZMK_SPLIT_ROLE_CENTRAL
    default y

endif # SHIELD_BOARD1_LEFT

if SHIELD_BOARD1_LEFT || SHIELD_BOARD1_RIGHT

config ZMK_SPLIT
    default y

endif # SHIELD_BOARD1_LEFT || SHIELD_BOARD1_RIGHT
```

## boards/shields/board1/Kconfig.shield
```kconfig
config SHIELD_BOARD1_LEFT
    def_bool $(shields_list_contains,board1_left)

config SHIELD_BOARD1_RIGHT
    def_bool $(shields_list_contains,board1_right)
```
